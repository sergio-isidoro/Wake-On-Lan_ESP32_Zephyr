/ {
	aliases {
		sw0 = &user_button;
	};

	buttons {
		compatible = "gpio-keys";
		user_button: button_0 {
			gpios = <&gpio0 9 (GPIO_PULL_UP | GPIO_ACTIVE_LOW)>;
			label = "Boot Button";
		};
	};
};